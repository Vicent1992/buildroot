## package/vios/vios_app/ipc/Config.in
```kconfig
source "package/vios/app/ipc/vios_dbus/Config.in"
source "package/vios/app/ipc/vios_dbus_cpp/Config.in"
```

## package/vios/vios_app/ipc/vios_dbus/Config.in
```kconfig
config BR2_PACKAGE_VIOS_APP_DBUS
	bool "vios app dbus test"
	select BR2_PACKAGE_DBUS
	select BR2_PACKAGE_EXPAT
```

## package/vios/vios_app/json/vios_nlohmann/Config.in
```kconfig
config BR2_PACKAGE_VIOS_APP_NLOHMANN
	bool "vios app nlohmann json test"
	select BR2_PACKAGE_JSON_FOR_MODERN_CPP
```

## package/vios/vios_app/media/vios_ffmpeg/Config.in
```kconfig
config BR2_PACKAGE_VIOS_APP_FFMPEG
	bool "vios app ffmpeg test"
	select BR2_PACKAGE_FFMPEG
```

## package/vios/vios_app/other/Config.in
```kconfig
source "package/vios/app/other/vios_libsigc/Config.in"
source "package/vios/app/other/vios_rxcpp/Config.in"
```
