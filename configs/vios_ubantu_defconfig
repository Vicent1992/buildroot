## configs/vios_ubantu_defconfig
```kconfig
BR2_x86_64=y
BR2_TOOLCHAIN_BUILDROOT_GLIBC=y
BR2_KERNEL_HEADERS_4_19=y
BR2_PACKAGE_GLIBC_2_22=y
BR2_TOOLCHAIN_BUILDROOT_CXX=y
BR2_ROOTFS_DEVICE_CREATION_DYNAMIC_EUDEV=y
# BR2_TARGET_ENABLE_ROOT_LOGIN is not set
# BR2_TARGET_GENERIC_GETTY is not set
BR2_PACKAGE_LINUX_FIRMWARE=y
BR2_PACKAGE_LINUX_FIRMWARE_ATHEROS_9170=y
BR2_PACKAGE_LINUX_FIRMWARE_ATHEROS_9271=y
BR2_PACKAGE_LINUX_FIRMWARE_IWLWIFI_3160=y
BR2_PACKAGE_LINUX_FIRMWARE_IWLWIFI_3168=y
BR2_PACKAGE_LINUX_FIRMWARE_IWLWIFI_5000=y
BR2_PACKAGE_LINUX_FIRMWARE_IWLWIFI_6000G2A=y
BR2_PACKAGE_LINUX_FIRMWARE_IWLWIFI_6000G2B=y
BR2_PACKAGE_LINUX_FIRMWARE_IWLWIFI_7260=y
BR2_PACKAGE_LINUX_FIRMWARE_IWLWIFI_7265D=y
BR2_PACKAGE_LINUX_FIRMWARE_IWLWIFI_8000C=y
BR2_PACKAGE_LINUX_FIRMWARE_IWLWIFI_8265=y
BR2_PACKAGE_LINUX_FIRMWARE_RALINK_RT73=y
BR2_PACKAGE_LINUX_FIRMWARE_RALINK_RT2XX=y
BR2_PACKAGE_LINUX_FIRMWARE_RTL_81XX=y
BR2_PACKAGE_LINUX_FIRMWARE_RTL_87XX=y
BR2_PACKAGE_LINUX_FIRMWARE_RTL_88XX=y
BR2_PACKAGE_LINUX_FIRMWARE_RTL_8169=y
BR2_PACKAGE_ACPID=y
BR2_PACKAGE_CONNMAN=y
BR2_PACKAGE_CONNMAN_WIFI=y
BR2_PACKAGE_CONNMAN_CLIENT=y
BR2_TARGET_ROOTFS_EXT2=y
BR2_TARGET_ROOTFS_EXT2_4=y
BR2_TARGET_ROOTFS_EXT2_SIZE="120M"
# BR2_TARGET_ROOTFS_TAR is not set
BR2_PACKAGE_HOST_GENIMAGE=y
```

## package/glibc/Config.in
```kconfig
if BR2_TOOLCHAIN_BUILDROOT_GLIBC

comment "Glibc Options"

config BR2_PACKAGE_GLIBC
	bool
	default y
	select BR2_PACKAGE_LINUX_HEADERS
	select BR2_TOOLCHAIN_HAS_SSP if BR2_PACKAGE_HOST_BINUTILS_SUPPORTS_CFI
	help
	  https://www.gnu.org/software/libc/

config BR2_PACKAGE_GLIBC_2_22
        bool "glibc 2.22"
        default y if !BR2_TOOLCHAIN_HEADERS_AT_LEAST_3_2
        # No support for pthread barriers on < v9 ISA
        depends on !BR2_sparc

config BR2_PACKAGE_GLIBC_UTILS
	bool "Install glibc utilities"
	help
	  Enabling this option will compile and install the getconf,
	  ldconfig, ldd and locale glibc utilities for the target.

endif # BR2_TOOLCHAIN_BUILDROOT_GLIBC
```

## package/vios/Config.in
```kconfig
# Vios BSP packages

## Vios BSP App package
source "package/vios/vios_app/Config.in"
source "package/vios/external/Config.in"
source "package/vios/system/Config.in"
```

## package/vios/app/Config.in
```kconfig
# Vios App packages
menu "Vios App Package"

source "package/vios/app/audio/Config.in"
source "package/vios/app/graphic/Config.in"
source "package/vios/app/program/Config.in"

endmenu
```

## package/vios/app/graphic/Config.in
```kconfig
source "package/vios/app/graphic/vios_freetype/Config.in"
source "package/vios/app/graphic/jpeg/Config.in"
source "package/vios/app/graphic/vios_sdl2/Config.in"
```

## package/vios/app/graphic/vios_freetype/Config.in
```kconfig
config BR2_PACKAGE_VIOS_APP_FREETYPE
	bool "vios app freetype test"
	select BR2_PACKAGE_FREETYPE
```

## package/vios/app/ipc/vios_dbus_cpp/Config.in
```kconfig
config BR2_PACKAGE_VIOS_APP_DBUS_CPP
	bool "vios app dbus_cpp test"
	select BR2_PACKAGE_DBUS
	select BR2_PACKAGE_EXPAT
	select BR2_PACKAGE_DBUS_CPP
	select BR2_PACKAGE_LIBGLIB2
	select BR2_PACKAGE_JSON_FOR_MODERN_CPP
```

## package/vios/app/json/Config.in
```kconfig
source "package/vios/app/json/vios_jsonc/Config.in"
source "package/vios/app/json/vios_nlohmann/Config.in"
```

## package/vios/app/json/vios_jsonc/Config.in
```kconfig
config BR2_PACKAGE_VIOS_APP_JSONC
	bool "vios app json-c test"
	select BR2_PACKAGE_JSON_C
```

## package/vios/app/other/vios_libsigc/Config.in
```kconfig
config BR2_PACKAGE_VIOS_APP_LIBSIGC
	bool "vios app libsigc++ test"
	select BR2_PACKAGE_LIBSIGC
```

## package/vios/external/Config.in
```kconfig
# Vios External Libraries packages
menu "Vios External Libraries Package"

source "package/vios/external/rxcpp/Config.in"
source "package/vios/external/catch/Config.in"

endmenu
```

## package/vios/external/catch/Config.in
```kconfig
config BR2_PACKAGE_CATCH
	bool "catch"
	depends on BR2_TOOLCHAIN_GCC_AT_LEAST_4_8 # C++11
	depends on BR2_INSTALL_LIBSTDCPP
	help
	  A modern, C++-native, header-only, test framework.
```

## package/vios/external/rxcpp/Config.in
```kconfig
config BR2_PACKAGE_RXCPP
	bool "rxcpp"
	depends on BR2_TOOLCHAIN_GCC_AT_LEAST_4_8 # C++11
	depends on BR2_INSTALL_LIBSTDCPP
	select BR2_PACKAGE_CATCH
	help
	  The Reactive Extensions for C++ (RxCpp) is a library of
	  algorithms for values-distributed-in-time
```

## package/vios/system/Config.in
```kconfig
# Vios System Libraries packages
menu "Vios System Libraries Package"

source "package/vios/system/vios_utils/Config.in"

endmenu
```

## package/vios/vios_app/Config.in
```kconfig
# Vios App packages
menu "Vios App Package"

config BR2_PACKAGE_VIOS_APP_MEDIA
	bool "vios app media apps"
if BR2_PACKAGE_VIOS_APP_MEDIA

config BR2_PACKAGE_VIOS_APP_MEDIA_OPENCV
	bool "vios app media opencv apps"

endif

endmenu
```

## package/vios/vios_app/audio/vios_alsa/Config.in
```kconfig
config BR2_PACKAGE_VIOS_APP_ALSA
	bool "vios app alsa test"
	select BR2_PACKAGE_ALSA_LIB
```

## package/vios/vios_app/graphic/jpeg/vios_exiv2/Config.in
```kconfig
config BR2_PACKAGE_VIOS_APP_EXIV2
	bool "vios app exiv2 test"
	select BR2_PACKAGE_EXIV2
```

## package/vios/vios_app/graphic/vios_sdl2/Config.in
```kconfig
config BR2_PACKAGE_VIOS_APP_SDL2
	bool "vios app sdl2 test"
	select BR2_PACKAGE_SDL2
	select BR2_PACKAGE_SDL2_TTF
	select BR2_PACKAGE_FREETYPE
	select BR2_PACKAGE_LIBPNG
	select BR2_PACKAGE_LIBZIP
```
